## apps/lvgl-ui/Kconfig
```kconfig
menuconfig AIC_LVGL_DEMO_APP
	bool "ArtInChip LVGL Demo App"
	default n
	depends on GRAPHICS_LVGL
	---help---
		Build the ArtInChip LVGL demo application (lv_demo).

if AIC_LVGL_DEMO_APP

choice
	prompt "AIC LVGL Demo"
	default AIC_LVGL_DASHBOARD_DEMO
	---help---
		Select which sub-application to build. Only one can be
		selected because each provides its own ui_init() entry.

config AIC_LVGL_DASHBOARD_DEMO
	bool "Dashboard Demo"
	---help---
		Build the dashboard demo: a speedometer-style instrument
		panel with arc gauge, signal indicators, and trip meter.

config AIC_LVGL_UI_BUILDER
	bool "UI Builder"
	---help---
		Build the UI generated by UIBuilder

endchoice

config AIC_LVGL_DEMO_PRIORITY
	int "lv_demo task priority"
	default 100

config AIC_LVGL_DEMO_STACKSIZE
	int "lv_demo stack size"
	default 40960

endif # AIC_LVGL_DEMO_APP
```

## apps/tpinput/Kconfig
```kconfig
#
# Copyright (c) 2024 ArtInChip Technology Co., Ltd.
#
# SPDX-License-Identifier: Apache-2.0
#

config AIC_TS_TEST
	bool "ArtInChip Touchscreen Test"
	default n
	---help---
		Enable the ArtInChip touchscreen test application.

if AIC_TS_TEST

config AIC_TS_TEST_DEVPATH
	string "Touchscreen Device Path"
	default "/dev/input0"
	---help---
		Path to the touchscreen input device.

endif
```

## boards/d12x/demo68-nor/Kconfig
```kconfig
config D12X_DEMO_NSH
	bool "Enable the NSH function on the 'D12X_DEMO' board"

config ARCH_BOARD_D12X_DEMO
    select ARCH_FPU
    select ARCH_RV_ISA_M
    select ARCH_RV_ISA_A
    select ARCH_RV_ISA_C
    select ONESHOT_COUNT
    bool "Enable the 'D12X_DEMO' board"

if ARCH_BOARD_D12X_DEMO

choice
    prompt "Target Board Selection"
    default AIC_TARGET_D12X_DEMO68_NOR
    help
      Select the target board configuration.

config AIC_TARGET_D12X_DEMO68_NOR
    bool "Demo68 NOR"

config AIC_TARGET_D12X_DEMO68_NAND
    bool "Demo68 NAND"

config AIC_TARGET_D12X_DEMO68_MMC
    bool "Demo68 MMC"

config AIC_TARGET_D12X_HMI_NOR
    bool "HMI NOR"

endchoice

config AIC_TARGET_DIR_NAME
    string
    default "demo68-nor" if AIC_TARGET_D12X_DEMO68_NOR
    default "demo68-nand" if AIC_TARGET_D12X_DEMO68_NAND
    default "demo68-mmc" if AIC_TARGET_D12X_DEMO68_MMC
    default "hmi-nor" if AIC_TARGET_D12X_HMI_NOR

endif
```

## chips/artinchips/Kconfig
```kconfig
#
# For a description of the syntax of this configuration file,
# see the file kconfig-language.txt in the NuttX tools repository.
#

config ARCH_CHIP_D12X
	bool
	default y
	select ARCH_RV32
	select ARCH_RV_ISA_M
	select ARCH_RV_ISA_A
	select ARCH_RV_ISA_C
	select ARCH_HAVE_FPU
	select ARCH_FPU
    select ARCH_HAVE_RESET

if ARCH_CHIP_D12X

menu "AIC Chip Configuration"

#---------------------------
# uart device global option
#---------------------------
config AIC_USING_UART0
    bool "Using Uart0"
    default n

config AIC_USING_UART1
    bool "Using Uart1"
    default n

config AIC_USING_UART2
    bool "Using Uart2"
    default n

config AIC_USING_UART3
    bool "Using Uart3"
    default n

menu "D12X Display Support"
source "../vendor/artinchip/chips/artinchips/drv/display/Kconfig"
endmenu


#---------------------------
# i2c device global option
#---------------------------
config AIC_USING_SOFT_I2C
    bool "Using SOFT_I2C"
    default n
	select I2C           # Enable bus-level I2C support (required)
    select I2C_DRIVER    # Enable character device interface (/dev/i2c-x)

config AIC_USING_I2C0
    bool "Using I2C0"
    default n
	select I2C           # Enable bus-level I2C 0 support (required)
    select I2C_DRIVER    # Enable character device interface (/dev/i2c-x)

config AIC_USING_I2C1
    bool "Using I2C1"
    default n
	select I2C           # Enable bus-level I2C 1 support (required)
    select I2C_DRIVER    # Enable character device interface (/dev/i2c-x)

config AIC_USING_PWM
    bool "Using PWM"
    default n
	depends on PWM           # Enable bus-level PWM support (required)



config AIC_USING_CTP
    bool "using CTP"
    default n


if AIC_USING_CTP
    source "../vendor/artinchip/chips/artinchips/peripheral/touch/Kconfig"
endif

source "../vendor/artinchip/chips/artinchips/drv/Kconfig"
source "../vendor/artinchip/chips/artinchips/hal/Kconfig"

source "../vendor/artinchip/chips/artinchips/mpp/Kconfig"

endmenu

endif
```

## chips/artinchips/drv/ge/Kconfig
```kconfig
config AIC_GE_DRV
    bool "Graphics Engine (GE) driver"
    default n
    help
      Enable Graphics Engine (GE) 2D hardware accelerator driver.
      Supports FILLRECT, BITBLT, ROTATE operations with alpha blending,
      color space conversion, scaling, and CMDQ batch mode.

if AIC_GE_DRV

choice
    prompt "Select Graphics Engine Mode"
    default AIC_GE_NORMAL

config AIC_GE_CMDQ
    bool "CMD queue mode"
    help
      Enable CMD Queue

config AIC_GE_NORMAL
    bool "normal mode"
    help
      Disable CMD Queue
endchoice

config AIC_GE_DITHER
    bool "Dither function"
    default y
    help
        Turning off the Dither function can save memory about 16K bytes.

config AIC_GE_CMDQ_BUF_LENGTH
    depends on AIC_GE_CMDQ
    int "CMDQ queue buffer"
    range 1024 16384
    default 2048

config AIC_GE_DRV_V11
    bool "GE hardware version V1.1"
    default y
    help
      Enable if SoC has GE hardware version 1.1.
      If not set, uses default (V1.0) register layout.

endif
```

## chips/artinchips/drv/ve/Kconfig
```kconfig
config AIC_VE_DRV
    bool "Video Engine (VE) driver"
    default n
    help
      Enable Video Engine (VE) hardware codec driver.

if AIC_VE_DRV

choice
    prompt "Select VE hardware version"
    default AIC_VE_DRV_V40

config AIC_VE_DRV_V10
    bool "VE V1.0"
    help
      VE hardware version 1.0. Supports JPEG/PNG/H.264.

config AIC_VE_DRV_V30
    bool "VE V3.0"
    help
      VE hardware version 3.0. Supports JPEG/PNG.

config AIC_VE_DRV_V40
    bool "VE V4.0"
    help
      VE hardware version 4.0. Supports JPEG/PNG.
      Includes SRAM mapping feature.
endchoice

endif
```

## chips/artinchips/mpp/Kconfig
```kconfig
config AIC_MPP
    bool "Media Processing Pipeline (MPP)"
    default n
    help
      Enable ArtInChip Media Processing Pipeline.
      Provides high-level API for GE (Graphics Engine) and VE (Video Engine).

if AIC_MPP

config AIC_MPP_LOG_LEVEL
	int "MPP log level (0=err 1=warn 2=info 3=debug)"
	default 0
	range 0 3
	help
	  Control the MPP log verbosity:
	  0 = Error only
	  1 = Error + Warning
	  2 = Error + Warning + Info
	  3 = Error + Warning + Info + Debug

config AIC_PIC_DEC_TEST
    bool "Picture decode test (pic_dec_test)"
    depends on AIC_VE_DRV
    default n
    help
      Picture decode test application. Decodes JPEG/PNG images
      using VE hardware decoder and displays via GE + FB.
      Usage: pic_dec_test -i <input_file> [-f <format>] [-r <rotate>] [-s <scale>]

endif # AIC_MPP
```
